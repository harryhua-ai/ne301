/*
 * test_sign_spike.c — Issue #32 offline signing feasibility spike (AC2).
 *
 * Signs and verifies a FIXED 64-byte string with ECDSA P-256 / SHA-256 using
 * the firmware's own mbedTLS 3.6.4 sources (Custom/Common/Lib/MbedTLS) built
 * with the firmware's real configuration
 * (configs/config-ccm-psk-tls1_2.h + morselib tail include) adapted for host
 * compilation by host_user_config.h (hardware ALT hooks disabled — see that
 * file and Docs/design/app-signing-feasibility.md).
 *
 * ALL private material below is NON-PRODUCTION, throwaway, test-only key
 * material generated by gen_vectors.sh on this machine. It must never be used
 * for anything real.
 *
 * Cases:
 *   V1  sign fixed byte string in-process, verify OK
 *   V2  verify openssl-generated committed signature via pk_parse_public_key
 *       (SPKI DER) + pk_verify — the realistic device ingestion path
 *   V3  SHA-256 primitive digest matches independently computed constant
 *   N1  message tampered (1 bit)        -> rejected
 *   N2  signature r tampered            -> rejected
 *   N3  signature s tampered            -> rejected
 *   N4  wrong public key (key2, derived)-> rejected
 *   N5  wrong public key (key2 SPKI DER)-> rejected
 *   N6  truncated DER signature         -> rejected
 *   N7  trailing garbage after DER      -> rejected
 *   N8  r = 0 (invalid range)           -> rejected
 *   N9  s = 0xFF..FF (> group order)    -> rejected
 *   N10 s as negative INTEGER (no pad)  -> rejected (behaviour recorded)
 *   N11 BER indefinite length 0x30 0x80 -> rejected (behaviour recorded)
 */

#include <stdio.h>
#include <stdlib.h>
#include <string.h>
#include <stdint.h>

#include "mbedtls/build_info.h"
#include "mbedtls/ecp.h"
#include "mbedtls/ecdsa.h"
#include "mbedtls/pk.h"
#include "mbedtls/sha256.h"
#include "mbedtls/asn1.h"
#include "mbedtls/error.h"

/* ------------------------------------------------------------------ */
/* Fixed byte string under test (byte-exact with gen_vectors.sh and   */
/* vectors/spike_message.bin).                                        */
static const uint8_t MSG[64] =
    "NE301 app-signing spike fixed byte string #1 0123456789abcdef###";

/* NON-PRODUCTION test scalars (generated by gen_vectors.sh; committed
 * vectors/ecdsa_p256_spike_testkey{1,2}.pem hold the same throwaway keys). */
static const uint8_t TEST_D1[32] = {
    0xd7, 0x50, 0x1b, 0xa2, 0xce, 0xbf, 0x88, 0xa7,
    0x2e, 0x83, 0x7c, 0x6e, 0x03, 0x0d, 0x20, 0x76,
    0xad, 0xbb, 0x95, 0x0a, 0x3e, 0x5e, 0xf2, 0x5a,
    0xdd, 0xcc, 0x4a, 0xa5, 0x25, 0x26, 0x96, 0x58
};
static const uint8_t TEST_D2[32] = {
    0xdf, 0x6b, 0xb8, 0xf3, 0x98, 0xa5, 0xda, 0xd5,
    0x8a, 0x2d, 0x72, 0x0f, 0xee, 0xf9, 0x40, 0x06,
    0x92, 0x07, 0xf8, 0x13, 0x3c, 0xda, 0xc9, 0x5f,
    0xb7, 0xb7, 0x18, 0x7b, 0xee, 0x21, 0xca, 0x12
};

/* SHA-256("NE301 app-signing spike fixed byte string #1 0123456789abcdef###")
 * computed independently with openssl (gen_vectors step, recorded in the
 * design doc). */
static const uint8_t EXPECTED_SHA256[32] = {
    0x01, 0xf6, 0x20, 0xa3, 0xd9, 0xd0, 0xf1, 0x11,
    0x9f, 0xa1, 0xd2, 0x32, 0xc4, 0xa7, 0x36, 0xf3,
    0x39, 0x12, 0x22, 0x52, 0x17, 0x68, 0x84, 0x41,
    0x3a, 0x91, 0x38, 0x07, 0x25, 0x12, 0xa3, 0x04
};

/* ------------------------------------------------------------------ */
static int g_checks;
static int g_failures;

static void check(int cond, const char *name, int rc)
{
    g_checks++;
    if (cond) {
        printf("PASS %-34s (rc=%d)\n", name, rc);
    } else {
        g_failures++;
        printf("FAIL %-34s (rc=%d = -0x%04x)\n", name, rc, (unsigned)-rc);
    }
}

/* Deterministic xorshift128 RNG — TEST ONLY, not a security primitive. Used
 * for ECDSA blinding and per-signature k selection. */
static int test_rng(void *p, unsigned char *out, size_t len)
{
    static uint32_t s0 = 0x243F6A88u, s1 = 0x85A308D3u;
    static uint32_t s2 = 0x13198A2Eu, s3 = 0x03707344u;
    (void)p;
    for (size_t i = 0; i < len; i++) {
        uint32_t t = s0 ^ (s0 << 11);
        s0 = s1; s1 = s2; s2 = s3;
        t ^= t >> 8;
        s3 = s3 ^ (s3 >> 19) ^ t;
        out[i] = (unsigned char)(s3 & 0xFFu);
    }
    return 0;
}

static int load_file(const char *path, unsigned char *buf, size_t cap, size_t *len)
{
    FILE *f = fopen(path, "rb");
    if (f == NULL) {
        return -1;
    }
    *len = fread(buf, 1, cap, f);
    fclose(f);
    return 0;
}

static void print_hex(const char *label, const uint8_t *buf, size_t len)
{
    printf("%s", label);
    for (size_t i = 0; i < len; i++) {
        printf("%02x", buf[i]);
    }
    printf("\n");
}

/* Build a fresh P-256 mbedtls_ecdsa_context from a 32-byte private scalar and
 * derive the matching public point. */
static int make_key(uint8_t scalar[32], mbedtls_ecdsa_context *ctx)
{
    int rc;
    mbedtls_ecdsa_init(ctx);
    rc = mbedtls_ecp_group_load(&ctx->grp, MBEDTLS_ECP_DP_SECP256R1);
    if (rc != 0) {
        return rc;
    }
    rc = mbedtls_mpi_read_binary(&ctx->d, scalar, 32);
    if (rc != 0) {
        return rc;
    }
    rc = mbedtls_ecp_mul(&ctx->grp, &ctx->Q, &ctx->d, &ctx->grp.G, test_rng, NULL);
    return rc;
}

/* Locate the two INTEGER records (tag byte through content end) inside a DER
 * ECDSA-Sig-Value. Layout: 30 LL 02 LR <r> 02 LS <s> (short-form lengths). */
static int parse_sig_ints(const uint8_t *sig, size_t sig_len,
                          size_t *r_off, size_t *r_len,
                          size_t *s_off, size_t *s_len)
{
    if (sig_len < 8 || sig[0] != 0x30 || (sig[1] & 0x80) != 0) {
        return -1;
    }
    if (sig[2] != 0x02 || (sig[3] & 0x80) != 0) {
        return -1;
    }
    *r_off = 2;
    *r_len = (size_t)2 + sig[3];
    if (4 + sig[3] >= sig_len) {
        return -1;
    }
    *s_off = 4 + sig[3];
    if (sig[*s_off] != 0x02 || (sig[*s_off + 1] & 0x80) != 0) {
        return -1;
    }
    *s_len = (size_t)2 + sig[*s_off + 1];
    if (*r_off + *r_len + *s_len != sig_len) {
        return -1;
    }
    return 0;
}

/* Assemble SEQUENCE { int1, int2 } with short-form length. */
static size_t build_sig(uint8_t *out, const uint8_t *int1, size_t int1_len,
                        const uint8_t *int2, size_t int2_len)
{
    size_t body = int1_len + int2_len;
    out[0] = 0x30;
    out[1] = (uint8_t)body;
    memcpy(out + 2, int1, int1_len);
    memcpy(out + 2 + int1_len, int2, int2_len);
    return body + 2;
}

/* Print which configuration modules this binary was actually compiled with
 * (AC1 runtime self-evidence; complements host_user_config.h). */
static void print_build_evidence(void)
{
    printf("mbedtls version           : %s\n", MBEDTLS_VERSION_STRING);
#if defined(MBEDTLS_ECDSA_C)
    printf("  MBEDTLS_ECDSA_C           : 1\n");
#else
    printf("  MBEDTLS_ECDSA_C           : 0\n");
#endif
#if defined(MBEDTLS_ECP_C)
    printf("  MBEDTLS_ECP_C             : 1\n");
#else
    printf("  MBEDTLS_ECP_C             : 0\n");
#endif
#if defined(MBEDTLS_ECP_DP_SECP256R1_ENABLED)
    printf("  ECP_DP_SECP256R1_ENABLED  : 1\n");
#else
    printf("  ECP_DP_SECP256R1_ENABLED  : 0\n");
#endif
#if defined(MBEDTLS_SHA256_C)
    printf("  MBEDTLS_SHA256_C          : 1\n");
#else
    printf("  MBEDTLS_SHA256_C          : 0\n");
#endif
#if defined(MBEDTLS_ASN1_PARSE_C)
    printf("  MBEDTLS_ASN1_PARSE_C      : 1\n");
#else
    printf("  MBEDTLS_ASN1_PARSE_C      : 0\n");
#endif
#if defined(MBEDTLS_ASN1_WRITE_C)
    printf("  MBEDTLS_ASN1_WRITE_C      : 1\n");
#else
    printf("  MBEDTLS_ASN1_WRITE_C      : 0\n");
#endif
#if defined(MBEDTLS_BIGNUM_C)
    printf("  MBEDTLS_BIGNUM_C          : 1\n");
#else
    printf("  MBEDTLS_BIGNUM_C          : 0\n");
#endif
#if defined(MBEDTLS_PK_C)
    printf("  MBEDTLS_PK_C              : 1\n");
#else
    printf("  MBEDTLS_PK_C              : 0\n");
#endif
#if defined(MBEDTLS_PK_PARSE_C)
    printf("  MBEDTLS_PK_PARSE_C        : 1\n");
#else
    printf("  MBEDTLS_PK_PARSE_C        : 0\n");
#endif
#if defined(MBEDTLS_PK_WRITE_C)
    printf("  MBEDTLS_PK_WRITE_C        : 1\n");
#else
    printf("  MBEDTLS_PK_WRITE_C        : 0\n");
#endif
#if defined(MBEDTLS_PEM_PARSE_C)
    printf("  MBEDTLS_PEM_PARSE_C       : 1\n");
#else
    printf("  MBEDTLS_PEM_PARSE_C       : 0\n");
#endif
#if defined(MBEDTLS_USE_PSA_CRYPTO)
    printf("  MBEDTLS_USE_PSA_CRYPTO    : 1\n");
#else
    printf("  MBEDTLS_USE_PSA_CRYPTO    : 0\n");
#endif
    /* Deviations applied by host_user_config.h must all read 0 here. */
#if defined(MBEDTLS_ECDSA_VERIFY_ALT)
    printf("  MBEDTLS_ECDSA_VERIFY_ALT  : 1 (HOST DEVIATION — must be 0)\n");
#else
    printf("  MBEDTLS_ECDSA_VERIFY_ALT  : 0 (host software path)\n");
#endif
#if defined(MBEDTLS_ECDSA_SIGN_ALT)
    printf("  MBEDTLS_ECDSA_SIGN_ALT    : 1 (HOST DEVIATION — must be 0)\n");
#else
    printf("  MBEDTLS_ECDSA_SIGN_ALT    : 0 (host software path)\n");
#endif
#if defined(MBEDTLS_SHA256_ALT)
    printf("  MBEDTLS_SHA256_ALT        : 1 (HOST DEVIATION — must be 0)\n");
#else
    printf("  MBEDTLS_SHA256_ALT        : 0 (host software path)\n");
#endif
}

int main(void)
{
    int rc;
    uint8_t hash[32];
    uint8_t sig[256];
    size_t sig_len = 0;
    mbedtls_ecdsa_context key1;
    mbedtls_ecdsa_context key2;
    mbedtls_pk_context pk1;
    mbedtls_pk_context pk2;
    unsigned char vec_msg[64];
    unsigned char vec_sig[256];
    unsigned char spki1[256];
    unsigned char spki2[256];
    size_t vec_msg_len = 0, vec_sig_len = 0, spki1_len = 0, spki2_len = 0;

    printf("=== Issue #32 sign/verify spike (mbedTLS from firmware tree) ===\n");
    print_build_evidence();

    /* ---- setup: two NON-PRODUCTION keypairs ---- */
    rc = make_key((uint8_t *)TEST_D1, &key1);
    check(rc == 0, "setup_derive_key1", rc);
    rc = make_key((uint8_t *)TEST_D2, &key2);
    check(rc == 0, "setup_derive_key2(wrong-key)", rc);
    if (g_failures > 0) {
        printf("setup failed, aborting\n");
        return 1;
    }

    /* ---- V3: SHA-256 primitive digest ---- */
    rc = mbedtls_sha256(MSG, sizeof(MSG), hash, 0);
    check(rc == 0, "V3_sha256_primitive", rc);
    check(memcmp(hash, EXPECTED_SHA256, 32) == 0, "V3_sha256_matches_openssl", -1);
    print_hex("MSG sha256 = ", hash, 32);

    /* ---- V1: sign the exact fixed byte string, verify OK ---- */
    rc = mbedtls_ecdsa_write_signature(&key1, MBEDTLS_MD_SHA256, hash, sizeof(hash),
                                       sig, sizeof(sig), &sig_len, test_rng, NULL);
    check(rc == 0, "V1_sign_fixed_bytestring", rc);
    rc = mbedtls_ecdsa_read_signature(&key1, hash, sizeof(hash), sig, sig_len);
    check(rc == 0, "V1_verify_valid_signature", rc);

    /* ---- load committed vectors (openssl-generated) ---- */
    if (load_file("vectors/spike_message.bin", vec_msg, sizeof(vec_msg), &vec_msg_len) != 0 ||
        load_file("vectors/spike_message.sig.der", vec_sig, sizeof(vec_sig), &vec_sig_len) != 0 ||
        load_file("vectors/ecdsa_p256_spike_testkey1_pub.spki.der", spki1, sizeof(spki1), &spki1_len) != 0 ||
        load_file("vectors/ecdsa_p256_spike_testkey2_pub.spki.der", spki2, sizeof(spki2), &spki2_len) != 0) {
        printf("FAIL vector_load (missing vectors/? run gen_vectors.sh)\n");
        return 1;
    }
    check(vec_msg_len == sizeof(MSG) && memcmp(vec_msg, MSG, 64) == 0,
          "vector_message_bytes_identical", -1);

    /* ---- V2: openssl signature + SPKI pubkey via PK layer ---- */
    mbedtls_pk_init(&pk1);
    rc = mbedtls_pk_parse_public_key(&pk1, spki1, spki1_len);
    check(rc == 0, "V2_pk_parse_public_key(spki)", rc);
    rc = mbedtls_pk_verify(&pk1, MBEDTLS_MD_SHA256, hash, sizeof(hash),
                           vec_sig, vec_sig_len);
    check(rc == 0, "V2_verify_openssl_signature", rc);
    /* cross-check the openssl signature against the in-process signed digest */
    rc = mbedtls_ecdsa_read_signature(&key1, hash, sizeof(hash), vec_sig, vec_sig_len);
    check(rc == 0, "V2_lowlevel_verify_openssl_sig", rc);

    /* ---- N1: message tamper ---- */
    {
        uint8_t bad[64];
        memcpy(bad, MSG, 64);
        bad[63] ^= 0x01;
        uint8_t bad_hash[32];
        rc = mbedtls_sha256(bad, sizeof(bad), bad_hash, 0);
        rc = (rc == 0) ? mbedtls_ecdsa_read_signature(&key1, bad_hash, 32, sig, sig_len) : rc;
        check(rc != 0, "N1_reject_message_tamper", rc);
    }

    /* ---- N2/N3: signature tamper (flip last content byte of r / of s) ---- */
    {
        size_t r_off, r_len, s_off, s_len;
        uint8_t bad[256];
        size_t bad_len;
        if (parse_sig_ints(sig, sig_len, &r_off, &r_len, &s_off, &s_len) != 0) {
            check(0, "N2_parse_own_sig", -1);
        } else {
            memcpy(bad, sig, sig_len);
            bad_len = sig_len;
            bad[r_off + r_len - 1] ^= 0x01;
            rc = mbedtls_ecdsa_read_signature(&key1, hash, 32, bad, bad_len);
            check(rc != 0, "N2_reject_signature_r_tamper", rc);

            memcpy(bad, sig, sig_len);
            bad_len = sig_len;
            bad[s_off + s_len - 1] ^= 0x01;
            rc = mbedtls_ecdsa_read_signature(&key1, hash, 32, bad, bad_len);
            check(rc != 0, "N3_reject_signature_s_tamper", rc);
        }
    }

    /* ---- N4: wrong public key (key2 context) ---- */
    rc = mbedtls_ecdsa_read_signature(&key2, hash, 32, sig, sig_len);
    check(rc != 0, "N4_reject_wrong_pubkey(derived)", rc);

    /* ---- N5: wrong public key via SPKI DER ---- */
    mbedtls_pk_init(&pk2);
    rc = mbedtls_pk_parse_public_key(&pk2, spki2, spki2_len);
    check(rc == 0, "N5_pk_parse_wrong_spki", rc);
    rc = mbedtls_pk_verify(&pk2, MBEDTLS_MD_SHA256, hash, sizeof(hash),
                           vec_sig, vec_sig_len);
    check(rc != 0, "N5_reject_wrong_pubkey(spki)", rc);

    /* ---- N6: truncated DER ---- */
    rc = mbedtls_ecdsa_read_signature(&key1, hash, 32, sig, sig_len - 1);
    check(rc != 0, "N6_reject_truncated_der", rc);

    /* ---- N7: trailing garbage ---- */
    {
        uint8_t bad[256];
        memcpy(bad, sig, sig_len);
        bad[sig_len] = 0xFF;
        rc = mbedtls_ecdsa_read_signature(&key1, hash, 32, bad, sig_len + 1);
        check(rc != 0, "N7_reject_trailing_garbage", rc);
    }

    /* ---- N8/N9/N10: synthetic non-canonical signatures ---- */
    {
        size_t r_off, r_len, s_off, s_len;
        uint8_t bad[256];
        size_t bad_len;
        uint8_t zeroes_int[3] = { 0x02, 0x01, 0x00 };
        uint8_t huge_s_int[35];
        uint8_t neg_s_int[34];

        if (parse_sig_ints(sig, sig_len, &r_off, &r_len, &s_off, &s_len) != 0) {
            check(0, "N8_parse_own_sig", -1);
        } else {
            /* N8: r = 0 */
            bad_len = build_sig(bad, zeroes_int, sizeof(zeroes_int),
                                sig + s_off, s_len);
            rc = mbedtls_ecdsa_read_signature(&key1, hash, 32, bad, bad_len);
            check(rc != 0, "N8_reject_r_zero", rc);

            /* N9: s = 0xFF..FF (> n) encoded as positive INTEGER */
            huge_s_int[0] = 0x02;
            huge_s_int[1] = 0x21;
            huge_s_int[2] = 0x00;
            memset(huge_s_int + 3, 0xFF, 32);
            bad_len = build_sig(bad, sig + r_off, r_len,
                                huge_s_int, sizeof(huge_s_int));
            rc = mbedtls_ecdsa_read_signature(&key1, hash, 32, bad, bad_len);
            check(rc != 0, "N9_reject_s_above_order", rc);

            /* N10: s encoded as negative INTEGER (no 0x00 padding) */
            neg_s_int[0] = 0x02;
            neg_s_int[1] = 0x20;
            neg_s_int[2] = 0x80;
            memset(neg_s_int + 3, 0xFF, 31);
            bad_len = build_sig(bad, sig + r_off, r_len,
                                neg_s_int, sizeof(neg_s_int));
            rc = mbedtls_ecdsa_read_signature(&key1, hash, 32, bad, bad_len);
            check(rc != 0, "N10_reject_negative_integer_s", rc);
        }
    }

    /* ---- N11: BER indefinite length ---- */
    {
        uint8_t bad[256];
        bad[0] = 0x30;
        bad[1] = 0x80;
        memcpy(bad + 2, sig, sig_len);
        rc = mbedtls_ecdsa_read_signature(&key1, hash, 32, bad, sig_len + 2);
        check(rc != 0, "N11_reject_ber_indefinite_len", rc);
    }

    mbedtls_pk_free(&pk1);
    mbedtls_pk_free(&pk2);
    mbedtls_ecdsa_free(&key1);
    mbedtls_ecdsa_free(&key2);

    printf("\n%d/%d checks passed\n", g_checks - g_failures, g_checks);
    return (g_failures == 0) ? 0 : 1;
}
